## CMakeLists.txt
```
cmake_minimum_required(VERSION 3.20.0)

find_package(Zephyr REQUIRED HINTS $ENV{ZEPHYR_BASE})
project(6sens_rtos_ttn)

FILE(GLOB app_sources src/*.c)
target_sources(app PRIVATE ${app_sources})
```

## prj.conf
```kconfig
# Debugger Support
CONFIG_CONSOLE=y
CONFIG_SERIAL=y
CONFIG_UART_CONSOLE=n

# RTT Segger Support
CONFIG_RTT_CONSOLE=y
CONFIG_USE_SEGGER_RTT=y

# Communication Bus Support
CONFIG_GPIO=y
CONFIG_SPI=y

# LoRa Support
CONFIG_LORA=y

# LoRaWAN Support
CONFIG_LORAWAN=y
CONFIG_HAS_SEMTECH_LORAMAC=y
CONFIG_LORAMAC_REGION_EU868=y
CONFIG_LORAWAN_SYSTEM_MAX_RX_ERROR=100

# Flash Memory Support
CONFIG_NVS=y
CONFIG_FLASH=y
CONFIG_FLASH_PAGE_LAYOUT=y
CONFIG_MPU_ALLOW_FLASH_WRITE=y

# Stack Support
CONFIG_MAIN_STACK_SIZE=2048
CONFIG_SYSTEM_WORKQUEUE_STACK_SIZE=2048
```

## src/main.c
```c
/*
 * Copyright (c) 2025
 * Regis Rousseau
 * Univ Lyon, INSA Lyon, Inria, CITI, EA3720
 * SPDX-License-Identifier: Apache-2.0
 */

//  ========== includes ====================================================================
#include "app_lorawan.h"

//  ========== globals =====================================================================
// define GPIO specifications for the LEDs used to indicate transmission (TX) and reception (RX)
static const struct gpio_dt_spec led_tx = GPIO_DT_SPEC_GET(LED_0, gpios);

static void dl_callback(uint8_t port, bool data_pending,
			int16_t rssi, int8_t snr,
			uint8_t len, const uint8_t *hex_data)
{
	printk("Port %d, Pending %d, RSSI %ddB, SNR %ddBm\n", port, data_pending, rssi, snr);
}

static void lorwan_datarate_changed(enum lorawan_datarate dr)
{
	uint8_t unused, max_size;

	lorawan_get_payload_sizes(&unused, &max_size);
	printk("new datarate: DR_%d, max payload %d\n", dr, max_size);
}

//  ========== main ========================================================================
int8_t main(void)
{
	char payload[] =  {'h', 'e', 'l', 'l', 'o', 'w', 'o', 'r', 'l', 'd'};
	int8_t ret;

	// configure LEDs for TX and RX indication
	gpio_pin_configure_dt(&led_tx, GPIO_OUTPUT_ACTIVE);
	gpio_pin_set_dt(&led_tx, 0);		// turn off TX LED

	const struct device *lora_dev;
	struct lorawan_join_config join_cfg;
	uint8_t dev_eui[] = LORAWAN_DEV_EUI;
	uint8_t join_eui[] = LORAWAN_JOIN_EUI;
	uint8_t app_key[] = LORAWAN_APP_KEY;

	lora_dev = DEVICE_DT_GET(DT_ALIAS(lora0));
	if (!device_is_ready(lora_dev)) {
		printk("%s: device not ready\n", lora_dev->name);
		return 0;
	}

	// start the LoRaWAN stack
	ret = lorawan_start();
	if (ret < 0) {
		printk("failed to start LoRaWAN stack. error: %d\n", ret);
		return 0;
	} else {
		
			// allow some time for the stack to stabilize
			k_sleep(K_MSEC(500));
	}

	printk("starting LoRaWAN stack\n");

    // set the region (Europe)
	ret = lorawan_set_region(LORAWAN_REGION_EU868);
	if (ret < 0) {
		printk("failed to start LoRaWAN stack. error: %d\n", ret);
		return 0;
	}

	// indicate device activity by toggling the reception LED
	gpio_pin_set_dt(&led_tx, 1);

	// enable Adaptive Data Rate (ADR) to optimize communication settings
    lorawan_enable_adr(true);

    // register downlink and data rate change callbacks for receiving messages and updates
	struct lorawan_downlink_cb downlink_cb = {
		.port = LW_RECV_PORT_ANY,
		.cb = dl_callback
	};
	lorawan_register_downlink_callback(&downlink_cb);
	lorawan_register_dr_changed_callback(lorwan_datarate_changed);  

	// configuration of lorawan network using OTAA
    join_cfg.mode = LORAWAN_ACT_OTAA;
	join_cfg.dev_eui = dev_eui;
	join_cfg.otaa.join_eui = join_eui;
	join_cfg.otaa.app_key = app_key;
	join_cfg.otaa.nwk_key = app_key;

	printk("joining network over OTAA\n");
	ret = lorawan_join(&join_cfg);
	if (ret < 0) {
		printk("lorawan_join_network failed. error: %d\n", ret);
		return 0;
	}

	// turn off LEDs to indicate the end of the process
	gpio_pin_set_dt(&led_tx, 0);
	printk("Test of LoRaWAN and TTN\n");

	// start the main loop for data simulation and transmission
	//for (int8_t i = 0; i < 5; i++) {
	while(1) {
		// indicate data transmission with the TX LED
		printk("sending random data...\n");
		gpio_pin_set_dt(&led_tx, 1);

		// send the payload over LoRaWAN (unconfirmed message)
		ret = lorawan_send(LORAWAN_PORT, payload, sizeof(payload), LORAWAN_MSG_CONFIRMED);
		
		// handle transmission errors
		if (ret == -EAGAIN) {
			printk("LoRaWAN send failed (retry). error: %d\n", ret);
			gpio_pin_set_dt(&led_tx, 0);
			k_sleep(K_SECONDS(10));
			continue;
		}
		
		// handle transmission errors
		if (ret < 0) {
			printk("LoRaWAN send failed. error: %d. retrying\n", ret);
			gpio_pin_set_dt(&led_tx, 0);
			return 0;
		}

		printk("data sent successfully!\n");
		// turn off LEDs to indicate the end of the process
		gpio_pin_set_dt(&led_tx, 0);

		// wait before the next iteration
		k_sleep(DELAY);
	}
	return 0;
}
```

## src/app_lorawan.h
```c
/*
 * Copyright (c) 2025
 * Regis Rousseau
 * Univ Lyon, INSA Lyon, Inria, CITI, EA3720
 * SPDX-License-Identifier: Apache-2.0
 */

#ifndef APP_LORAWAN_H
#define APP_LORAWAN_H

//  ========== includes ====================================================================
#include <zephyr/kernel.h>
#include <zephyr/device.h>
#include <zephyr/devicetree.h>
#include <zephyr/drivers/gpio.h>
#include <zephyr/drivers/lora.h>
#include <zephyr/lorawan/lorawan.h>

//  ========== defines =====================================================================
#define DELAY 			        K_MSEC(20000)
#define LED_0 DT_ALIAS(led0)

// customize based on network configuration
#define LORAWAN_DEV_EUI			{ 0x70, 0xB3, 0xD5, 0x7E, 0xD0, 0x06, 0xB4, 0x66 }
#define LORAWAN_JOIN_EUI		{ 0x00, 0x00, 0x00, 0x00, 0x00, 0x00, 0x00, 0x00 }
#define LORAWAN_APP_KEY			{ 0xC7, 0x32, 0x0F, 0x37, 0xFF, 0x62, 0xE0, 0xA8, 0x4E, 0x94, 0xC1, 0x9C, 0x27, 0x2B, 0xFA, 0x4C }
#define LORAWAN_PORT            2       // application port
#define MAX_JOIN_ATTEMPTS       10      // limiting join attempts

//  ========== prototypes ==================================================================
int8_t app_lorawan_init(void);

#endif /* APP_LORAWAN_H */
```

## src/app_nvs.c
```c
/*
 * Copyright (c) 2025
 * Regis Rousseau
 * Univ Lyon, INSA Lyon, Inria, CITI, EA3720
 * SPDX-License-Identifier: Apache-2.0
 */

//  ========== include =====================================================================
#include "app_nvs.h"

//  ========== app_flash_init ==============================================================
int8_t app_nvs_init(struct nvs_fs *fs)
{
	struct flash_pages_info info;
	int8_t ret = 0;
	ssize_t size = 0;

	// configure the storage partition in flash memory
	fs->flash_device = NVS_PARTITION_DEVICE;

	// check if the flash device is ready
	if (!device_is_ready(fs->flash_device)) {
		printk("flash device \"%s\" is not ready\n", fs->flash_device->name);
		return 0;
	}

	// set the offset of the NVS partition in flash memory
	fs->offset = NVS_PARTITION_OFFSET;

	// retrieve information about the flash memory page at the specified offset
	ret = flash_get_page_info_by_offs(fs->flash_device, fs->offset, &info);
	if (ret) {
		printk("unable to get page info. error: %d\n", ret);
		return ret;
	}
	
	// set the sector size for the NVS partition
	fs->sector_size = info.size;

	// validate the sector size
	if (!fs->sector_size) {
		printk("invalid sector size\n");
		return -1;
	}
	printk("sector size: %d\n", info.size);

	// mount the NVS partition on the flash memory
	fs->sector_count = 4U;		 // number of sectors allocated to the NVS partition
	ret = nvs_mount(fs);
	if (ret) {
		printk("flash to initialize flash memory. error: %d\n", ret);
		return 0;
	}
	return 0;
}

//  ========== app_flash_init_param ========================================================
int8_t app_nvs_init_param(struct nvs_fs *fs, uint16_t id, void *data)
{
	int8_t ret = 0;

	// try to read the data associated with the given ID from NVS
	ret = nvs_read(fs, id, data, sizeof(data));
	if (ret > 0) {
		// data exists: print the ID and the associated address
		printk("ID: %d, address: %s\n", id, data);
	} else {
		// no data found: log the absence and write the provided data to NVS
		printk("no address found, adding %s at id %d\n", data, id);
		(void)nvs_write(fs, id, data, sizeof(data));	
	}
	return 0;
}
```
